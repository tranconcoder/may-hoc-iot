## esp-idf/esp32_rfid/main/Kconfig.projbuild
```kconfig
menu "Example Configuration"

config ROUTER_SSID
    string "Router SSID"
        default "ROUTER_SSID"
        help
            Router SSID.

config ROUTER_PASSWORD
    string "Router password"
        default "ROUTER_PASSWORD"
        help
            Router password.

config WEBSERVER_IP
    string "Webserver IP address"
        default "192.168.1.203"
        help
            Webserver IP address.

config WEBSERVER_PORT
    int "Webserver port"
        default 3000
        help
            Webserver port

endmenu
```

## esp-idf/esp32cam_security_gate/main/Kconfig.projbuild
```kconfig
menu "Example Configuration"

config ROUTER_SSID
    string "Router SSID"
        default "ROUTER_SSID"
        help
            Router SSID.

config ROUTER_PASSWORD
    string "Router password"
        default "ROUTER_PASSWORD"
        help
            Router password.

config SERVER_IP
    string "Server IP address"
        default "192.168.1.203"
        help
            Server IP address.

config SERVER_PORT
    int "Server port"
        default "8070"
        help
            Server port.

config WEBSERVER_IP
    string "Webserver IP address"
        default "192.168.1.203"
        help
            Webserver IP address.

config WEBSERVER_PORT
    int "Webserver port"
        default 3000
        help
            Webserver port

endmenu
```
